## conf/layer.conf
```bitbake
# We have a conf and classes directory, add to BBPATH
BBPATH .= ":${LAYERDIR}"

# We have recipes-* directories, add to BBFILES
BBFILES += "${LAYERDIR}/recipes-*/*/*.bb \
            ${LAYERDIR}/recipes-*/*/*.bbappend"

BBFILE_COLLECTIONS += "meta-grinn-common-netboot"
BBFILE_PATTERN_meta-grinn-common-netboot = "^${LAYERDIR}/"
BBFILE_PRIORITY_meta-grinn-common-netboot = "11"

LAYERDEPENDS_meta-grinn-common-netboot = "core"
LAYERSERIES_COMPAT_meta-grinn-common-netboot = "scarthgap"

BBFILES_DYNAMIC += " \
    meta-grinn-astra-bsp:${LAYERDIR}/dynamic-layers/meta-grinn-astra-bsp/*/*/*.bbappend \
    meta-grinn-genio-bsp:${LAYERDIR}/dynamic-layers/meta-grinn-genio-bsp/*/*/*.bbappend \
"

IMAGE_CLASSES += "grinn-netboot-image"

GRINN_NETBOOT_NFS_ARTIFACTS:grinn-astra-som = "${IMAGE_LINK_NAME}.tar.zst"
GRINN_NETBOOT_NFS_ARTIFACTS:grinn-genio-som = "${IMAGE_LINK_NAME}.tar.zst"

GRINN_NETBOOT_TFTP_ARTIFACTS:grinn-astra-som = "Image ${MACHINE}.dtb SYNAIMG"
GRINN_NETBOOT_TFTP_ARTIFACTS:grinn-genio-som = "fitImage"
```
